## boards/shields/roBa/Kconfig.defconfig
```kconfig
if SHIELD_ROBA_L || SHIELD_ROBA_R

config ZMK_KEYBOARD_NAME
    default "roBa"

config ZMK_MOUSE
    default y

endif

if SHIELD_ROBA_R

config ZMK_SPLIT_ROLE_CENTRAL
    default y

endif
```
